/* DO NOT EDIT — generated by hw-proj from doc/system.yaml */
/* Regenerate with: hw-proj gen linker */

/* Memory regions */
MEMORY
{
    SRAM0 (rwx) : ORIGIN = 0x00000000, LENGTH = 0x10000
    TEX0 (rwx) : ORIGIN = 0x00000000, LENGTH = 0x10000
}
